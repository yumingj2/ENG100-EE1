/* Created by Tim Jin
 * Simon Memory Game on Arduino
 */

// Constants
const int button1 = 2;          // 1st button controls Yellow LED 
const int button2 = 4;          // 2nd button controls Orange LED
const int button3 = 6;          // 3rd button controls Green LED
const int button4 = 8;          // 4th button controls Red LED
const int led1 = 3;             // Yellow LED
const int led2 = 5;             // Orange LED
const int led3 = 7;             // Green LED
const int led4 = 9;             // Red LED
const int speaker = 10;         // Speaker
const int tones[] = {1915, 1700, 1519, 1432, 1200, 2700, 3500};

//Variables
int buttonSeq[] = {0,0,0,0,0,0};  // The sequence of the button pushed by user
int lightState[] = {0,0,0,0};     // The current state of the LEDs
int lightSeq[] = {0,0,0,0,0,0};   // The sequence of LED generated by the computer randomly
int rando = 0;                    //initialize random integer for loopgame_on. Will be from 1-4 later.
int currentPin = 0;               //initialize current pin
int right = 0;                    //This variable must be 1 in order to go to the next level
int leddelay = 200;               //Initializing time for LED. This will decrease as the level increases

void setup() {
  // Initialize inputs :
  randomSeed(analogRead(0));
  pinMode(button1, INPUT);
  pinMode(button2, INPUT);
  pinMode(button3, INPUT);
  pinMode(button4, INPUT);
  // Initialize outputs:
  pinMode(led1, OUTPUT);
  pinMode(led2, OUTPUT);
  pinMode(led3, OUTPUT);
  pinMode(led4, OUTPUT);
  // Initialize serial communication for debugging:
  // Serial.begin(9600);
}

void loop() {
  initiate();
  gameStart();
  //shows the user the current sequence
  for (int i = 0; i < 6; i++){
    currentPin = ((lightSeq[i] + 1) * 2) + 1
    digitalWrite(currentPin, HIGH);
    playTone(tones[i],1000);
    digitalWrite(currentPin, LOW);
    delay(1000);
  }

  // i is the current position in the sequence
  for (int i = 0; i < 6; i++) {
    //detect button push
    int buttonPush = 0; 
    while (buttonPush == 0) {
      for (int j = 0; j < 4; j++) { 
        if (digitalRead((i + 1) * 2) != 0) {
          buttonPush++;
          buttonSeq[i] = j;
        }
      }
    }
    if (buttonSeq[i] != lightSeq[i]){
      gameOver();
      break;
    } else {
      digitalWrite(((buttonSeq[i] + 1) * 2) + 1, HIGH);
      playTone(tones[i],500);
      digitalWrite(((buttonSeq[i] + 1) * 2) + 1, LOW);
      delay(500);
    }
  }
  gameWin();
}

void initiate(){
  //initialize the game
  for(int i = 0; i < 6; i++) {
    buttonSeq[i] = 0;
    lightSeq[i] = 0;
    long rand_num = random(1,200);
    if (rand_num <= 50)
      rando=0;
    else if (rand_num>50 && rand_num<=100)
      rando=1;
    else if (rand_num>100 && rand_num<=150)
      rando=2;
    else if (rand_num<=200)
      rando=3;
    //saves a random number in our n_array
    lightSeq[i] = rando;
  }
  //clear the variances
  currentPin = 0;
}

void playTone(int tone, int duration) {
  for (long i = 0; i < duration * 1000L; i += tone * 2) {
    digitalWrite(speaker, HIGH);
    delayMicroseconds(tone);
    digitalWrite(speaker, LOW);
    delayMicroseconds(tone);
  }
}

void gameStart() {
  playTone(tones[4],500)
  for (int i = 0; i < 3; i++) {
    digitalWrite(3,HIGH);
    delay(500);
    digitalWrite(3,LOW);
    digitalWrite(5,HIGH);
    delay(500);
    digitalWrite(5,LOW);
    digitalWrite(7,HIGH);
    delay(500);
    digitalWrite(7,LOW);
    digitalWrite(9,HIGH);
    delay(500);
    digitalWrite(9,LOW);
    delay(500);
  }
}

void gameWin() {
  playTone(tones[5],500)
  for (int i = 0; i < 3; i++) {
    digitalWrite(3,HIGH);
    digitalWrite(7,HIGH);
    delay(500);
    digitalWrite(3,LOW);
    digitalWrite(7,LOW);
    digitalWrite(5,HIGH);
    digitalWrite(9,HIGH);
    delay(500);
    digitalWrite(5,LOW);
    digitalWrite(9,LOW);
    delay(500);
  }
}

void gameOver() {
  playTone(tones[6],500);
  for (int i = 0; i < 3; i++) {
    digitalWrite(3,HIGH);
    digitalWrite(5,HIGH);
    digitalWrite(7,HIGH);
    digitalWrite(9,HIGH);
    delay(500);
    digitalWrite(3,LOW);
    digitalWrite(5,LOW);
    digitalWrite(7,LOW);
    digitalWrite(9,LOW);
    delay(500);
  }
}

